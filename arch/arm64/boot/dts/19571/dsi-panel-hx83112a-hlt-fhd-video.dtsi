/* Copyright (c) 2018-2019, The Linux Foundation. All rights reserved.
 *
 * This program is free software; you can redistribute it and/or modify
 * it under the terms of the GNU General Public License version 2 and
 * only version 2 as published by the Free Software Foundation.
 *
 * This program is distributed in the hope that it will be useful,
 * but WITHOUT ANY WARRANTY; without even the implied warranty of
 * MERCHANTABILITY or FITNESS FOR A PARTICULAR PURPOSE.  See the
 * GNU General Public License for more details.
 */

&mdss_mdp {
	dsi_hx83112a_hlt_video: qcom,mdss_dsi_hx83112a_hlt_video {
		qcom,mdss-dsi-panel-name =
			"hx83112a video mode dsi HLT panel";
		qcom,mdss-dsi-panel-type = "dsi_video_mode";

		qcom,mdss-dsi-virtual-channel-id = <0>;
		qcom,mdss-dsi-stream = <0>;
		qcom,mdss-dsi-h-left-border = <0>;
		qcom,mdss-dsi-h-right-border = <0>;
		qcom,mdss-dsi-v-top-border = <0>;
		qcom,mdss-dsi-v-bottom-border = <0>;
		qcom,mdss-dsi-bpp = <24>;
		qcom,mdss-dsi-color-order = "rgb_swap_rgb";
		qcom,mdss-dsi-underflow-color = <0xff>;
		qcom,mdss-dsi-border-color = <0>;
		qcom,mdss-dsi-h-sync-pulse = <0>;
		qcom,mdss-dsi-traffic-mode = "non_burst_sync_event";
		qcom,mdss-dsi-lane-map = "lane_map_0123";
		qcom,mdss-dsi-bllp-eof-power-mode;
		qcom,mdss-dsi-bllp-power-mode;
		qcom,mdss-dsi-tx-eot-append;
		qcom,mdss-dsi-lane-0-state;
		qcom,mdss-dsi-lane-1-state;
		qcom,mdss-dsi-lane-2-state;
		qcom,mdss-dsi-lane-3-state;
		qcom,mdss-dsi-dma-trigger = "trigger_sw";
		qcom,mdss-dsi-mdp-trigger = "none";
		qcom,mdss-dsi-lp11-init;
		qcom,mdss-dsi-bl-pmic-control-type = "bl_ctrl_dcs";
		qcom,mdss-dsi-bl-min-level = <1>;
		qcom,mdss-dsi-bl-max-level = <2047>;
		qcom,mdss-brightness-max-level = <2047>;
		qcom,mdss-dsi-reset-sequence = <1 10>, <0 10>, <1 60>; //LCD_RST-Initial code >=50ms
		qcom,mdss-pan-physical-width-dimension = <68>;
		qcom,mdss-pan-physical-height-dimension = <151>;

		qcom,mdss-dsi-display-timings {
			timing@0 {
				qcom,mdss-dsi-panel-width = <1080>;
				qcom,mdss-dsi-panel-height = <2400>;
				qcom,mdss-dsi-h-front-porch = <56>;
				qcom,mdss-dsi-h-back-porch = <56>;
				qcom,mdss-dsi-h-pulse-width = <48>;
				qcom,mdss-dsi-h-sync-skew = <0>;
				qcom,mdss-dsi-v-back-porch = <29>;
				qcom,mdss-dsi-v-front-porch = <50>;
				qcom,mdss-dsi-v-pulse-width = <2>;
				qcom,mdss-dsi-panel-framerate = <60>;
				qcom,mdss-dsi-on-command = [
					39 01 00 00 00 00 04 B9 83 11 2A
					15 01 00 00 08 00 02 35 00
					05 01 00 00 78 00 02 11 00
					39 01 00 00 08 00 03 5E 00 04
					39 01 00 00 08 00 03 51 08 00
					39 01 00 00 08 00 05 C9 00 08 76 01  //PWM=30KHZ
					15 01 00 00 08 00 02 55 01
					15 01 00 00 08 00 02 53 2C
					05 01 00 00 28 00 02 29 00];
				qcom,mdss-dsi-off-command = [
				  05 01 00 00 22 00 02 28 00
				  05 01 00 00 82 00 02 10 00]; //delay 130ms
				qcom,mdss-dsi-cabc-off-command = [
				  15 01 00 00 05 00 02 55 00
				];

				qcom,mdss-dsi-cabc-low-mode-command = [
				  15 01 00 00 05 00 02 55 01
				  39 01 00 00 00 00 17 E4 2D 01 2C 00 08 00 10 08 04 04 8F 80 AA A5 AB B0 C8 DE FF FF FF EF
				];

				qcom,mdss-dsi-cabc-high-mode-command = [
				  15 01 00 00 05 00 02 55 02
				  39 01 00 00 00 00 17 E4 2D 01 2C 00 08 00 10 08 04 04 00 24 28 32 47 50 8D B6 FC FF FF EF
				];
				qcom,mdss-dsi-on-command-state = "dsi_lp_mode";
				qcom,mdss-dsi-off-command-state = "dsi_lp_mode";
				qcom,mdss-dsi-cabc-off-command-state = "dsi_hs_mode";
				qcom,mdss-dsi-cabc-low-mode-command-state = "dsi_hs_mode";
				qcom,mdss-dsi-cabc-high-mode-command-state = "dsi_hs_mode";
			};
		};
	};
};
