/* Copyright (c) 2018-2019, The Linux Foundation. All rights reserved.
 *
 * This program is free software; you can redistribute it and/or modify
 * it under the terms of the GNU General Public License version 2 and
 * only version 2 as published by the Free Software Foundation.
 *
 * This program is distributed in the hope that it will be useful,
 * but WITHOUT ANY WARRANTY; without even the implied warranty of
 * MERCHANTABILITY or FITNESS FOR A PARTICULAR PURPOSE.  See the
 * GNU General Public License for more details.
 */

&mdss_mdp {
	dsi_nt36672a_tm_video: qcom,mdss_dsi_nt36672a_tm_video {
		qcom,mdss-dsi-panel-name =
			"NT36672A video mode dsi tm panel";
		qcom,mdss-dsi-panel-type = "dsi_video_mode";

		qcom,mdss-dsi-virtual-channel-id = <0>;
		qcom,mdss-dsi-stream = <0>;
		qcom,mdss-dsi-h-left-border = <0>;
		qcom,mdss-dsi-h-right-border = <0>;
		qcom,mdss-dsi-v-top-border = <0>;
		qcom,mdss-dsi-v-bottom-border = <0>;
		qcom,mdss-dsi-bpp = <24>;
		qcom,mdss-dsi-color-order = "rgb_swap_rgb";
		qcom,mdss-dsi-underflow-color = <0xff>;
		qcom,mdss-dsi-border-color = <0>;
		qcom,mdss-dsi-h-sync-pulse = <0>;
		qcom,mdss-dsi-traffic-mode = "non_burst_sync_event";
		qcom,mdss-dsi-lane-map = "lane_map_0123";
		qcom,mdss-dsi-bllp-eof-power-mode;
		qcom,mdss-dsi-bllp-power-mode;
		qcom,mdss-dsi-tx-eot-append;
		qcom,mdss-dsi-lane-0-state;
		qcom,mdss-dsi-lane-1-state;
		qcom,mdss-dsi-lane-2-state;
		qcom,mdss-dsi-lane-3-state;
		qcom,mdss-dsi-dma-trigger = "trigger_sw";
		qcom,mdss-dsi-mdp-trigger = "none";
		qcom,mdss-dsi-lp11-init;
		qcom,mdss-dsi-bl-pmic-control-type = "bl_ctrl_dcs";
		qcom,mdss-dsi-bl-min-level = <1>;
		qcom,mdss-dsi-bl-max-level = <2047>;
		qcom,mdss-brightness-max-level = <2047>;
		qcom,mdss-dsi-reset-sequence = <1 10>, <0 10>, <1 10>;
		qcom,mdss-pan-physical-width-dimension = <68>;
		qcom,mdss-pan-physical-height-dimension = <151>;

		qcom,mdss-dsi-display-timings {
			timing@0 {
				qcom,mdss-dsi-panel-width = <1080>;
				qcom,mdss-dsi-panel-height = <2400>;
				qcom,mdss-dsi-h-front-porch = <70>;
				qcom,mdss-dsi-h-back-porch = <80>;
				qcom,mdss-dsi-h-pulse-width = <14>;
				qcom,mdss-dsi-h-sync-skew = <0>;
				qcom,mdss-dsi-v-back-porch = <20>;
				qcom,mdss-dsi-v-front-porch = <44>;
				qcom,mdss-dsi-v-pulse-width = <10>;
				qcom,mdss-dsi-panel-framerate = <60>;
				qcom,mdss-dsi-on-command = [

					15 01 00 00 00 00 02 FF 25
					15 01 00 00 00 00 02 FB 01
					15 01 00 00 00 00 02 05 04
					15 01 00 00 00 00 02 17 82
					15 01 00 00 00 00 02 18 96
					15 01 00 00 00 00 02 19 0B

					15 01 00 00 00 00 02 FF F0
					15 01 00 00 00 00 02 FB 01
					15 01 00 00 00 00 02 A2 00
					15 01 00 00 00 00 02 FF 23
					15 01 00 00 00 00 02 FB 01
					15 01 00 00 00 00 02 00 68  //11bit
					15 01 00 00 00 00 02 07 00  //30KHz
					15 01 00 00 00 00 02 08 01
					15 01 00 00 00 00 02 09 00
					15 01 00 00 00 00 02 11 01
					15 01 00 00 00 00 02 12 95
					//APL_COMP
					15 01 00 00 00 00 02 15 68
					15 01 00 00 00 00 02 16 0B
					//GAMMACMP
					15 01 00 00 00 00 02 29 20
					15 01 00 00 00 00 02 2A 20
					15 01 00 00 00 00 02 2B 20
					//CABC_PWM_UI
					15 01 00 00 00 00 02 30 FF
					15 01 00 00 00 00 02 31 FD
					15 01 00 00 00 00 02 32 FA
					15 01 00 00 00 00 02 33 F7
					15 01 00 00 00 00 02 34 F4
					15 01 00 00 00 00 02 35 F0
					15 01 00 00 00 00 02 36 ED
					15 01 00 00 00 00 02 37 EC
					15 01 00 00 00 00 02 38 EB
					15 01 00 00 00 00 02 39 EA
					15 01 00 00 00 00 02 3A E9
					15 01 00 00 00 00 02 3B E8
					15 01 00 00 00 00 02 3D E7
					15 01 00 00 00 00 02 3F E6
					15 01 00 00 00 00 02 40 E5
					15 01 00 00 00 00 02 41 E4
					//CABC_PWM_STILL
					15 01 00 00 00 00 02 45 FF
					15 01 00 00 00 00 02 46 FA
					15 01 00 00 00 00 02 47 F2
					15 01 00 00 00 00 02 48 E8
					15 01 00 00 00 00 02 49 E4
					15 01 00 00 00 00 02 4A DC
					15 01 00 00 00 00 02 4B D7
					15 01 00 00 00 00 02 4C D5
					15 01 00 00 00 00 02 4D D3
					15 01 00 00 00 00 02 4E D2
					15 01 00 00 00 00 02 4F D0
					15 01 00 00 00 00 02 50 CE
					15 01 00 00 00 00 02 51 CD
					15 01 00 00 00 00 02 52 CB
					15 01 00 00 00 00 02 53 C6
					15 01 00 00 00 00 02 54 C3

					15 01 00 00 00 00 02 FF 10
					15 01 00 00 00 00 02 FB 01
					39 01 00 00 00 00 06 3B 03 14 36 04 04

					15 01 00 00 00 00 02 FF 10
					15 01 00 00 00 00 02 FB 01
					15 01 00 00 00 00 02 53 2C
					15 01 00 00 00 00 02 55 01
					15 01 00 00 00 00 02 35 00//open TE
					15 01 00 00 00 00 02 B0 01
					39 01 00 00 00 00 03 68 00 01
					05 01 00 00 78 00 02 11 00//120ms

					05 01 00 00 28 00 02 29 00//40ms
					];


				qcom,mdss-dsi-off-command = [
				  05 01 00 00 22 00 02 28 00
				  05 01 00 00 64 00 02 10 00]; //100ms

				qcom,mdss-dsi-post-panel-on-command = [
                                        15 00 00 00 01 00 02 FF 10
                                        15 00 00 00 00 00 02 FB 01
                                        39 00 00 00 00 00 03 51 07 FF
                                        //add for avoiding color reverse
                                        ];

				qcom,mdss-dsi-pre-off-command = [
                                        15 00 00 00 01 00 02 FF 10
                                        15 00 00 00 00 00 02 FB 01
                                        39 01 00 00 00 00 03 51 00 00];
				qcom,mdss-dsi-cabc-off-command = [
                                        15 00 00 00 01 00 02 FF 10
                                        15 00 00 00 00 00 02 FB 01
                                        15 00 00 00 00 00 02 55 00
                                        ];

				qcom,mdss-dsi-cabc-low-mode-command = [
                                        15 00 00 00 01 00 02 FF 10
                                        15 00 00 00 00 00 02 FB 01
                                        15 00 00 00 00 00 02 55 01
                                        ];
				qcom,mdss-dsi-cabc-high-mode-command = [
                                        15 00 00 00 01 00 02 FF 10
                                        15 00 00 00 00 00 02 FB 01
                                        15 00 00 00 00 00 02 55 02
				];
				qcom,mdss-dsi-on-command-state = "dsi_lp_mode";
				qcom,mdss-dsi-off-command-state = "dsi_lp_mode";
				qcom,mdss-dsi-cabc-off-command-state = "dsi_hs_mode";
				qcom,mdss-dsi-cabc-low-mode-command-state = "dsi_hs_mode";
				qcom,mdss-dsi-cabc-high-mode-command-state = "dsi_hs_mode";
				qcom,mdss-dsi-post-on-command-state = "dsi_hs_mode";
				qcom,mdss-dsi-pre-off-command-state = "dsi_hs_mode";
			};
		};
	};
};
