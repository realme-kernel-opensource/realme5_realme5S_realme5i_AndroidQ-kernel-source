## drivers/input/touchscreen/oppo_touchscreen/Novatek/Kconfig
```kconfig
source "drivers/input/touchscreen/oppo_touchscreen/Novatek/NT36525B_noflash/Kconfig"
```

## drivers/input/touchscreen/oppo_touchscreen/ilitek/Kconfig
```kconfig
source "drivers/input/touchscreen/oppo_touchscreen/ilitek/ilitek9881h_v3/Kconfig"
```

## drivers/input/touchscreen/oppo_touchscreen/ilitek/ilitek9881h_v3/Kconfig
```kconfig
#ifdef VENDOR_EDIT

config TOUCHPANEL_ILITEK_ILITEK9881H_V3
#	default y
	bool "TP ilitek ilitek9881h IC enable or not for OPPO"
	---help---
	say Y to enable driver for Touchpanel using ilitek ilitek9881h

#endif
```

## drivers/soc/oppo/force_dump/Kconfig
```kconfig
config OPPO_FORCE_DUMP
  bool "config oppo dump"
  help
	define this config to force dump.
```

## drivers/soc/oppo/oppo_healthinfo/Kconfig
```kconfig
#ifdef VENDOR_EDIT
config OPPO_HEALTHINFO
bool "config oppo healthinfo"
help
    define this config to init oppo healthinfo.
#endif /* VENDOR_EDIT */
```

## drivers/soc/oppo/oppo_kevent_feedback/Kconfig
```kconfig
#ifdef VENDOR_EDIT
config OPPO_CRITICALLOG
bool "config oppo kevent feedback"
help
    define this config to init oppo kevent feedback driver.
#endif /* VENDOR_EDIT */
```

## drivers/soc/oppo/oppo_phoenix/Kconfig
```kconfig
#change 'y' to 'n', if you want fo close phoenix feature
config OPPO_PHOENIX
    bool "oppo phoenix project"
    default y
    help
      define this config to init oppo phoenix project.
```

## drivers/soc/oppo/oppo_shutdown_detect/Kconfig
```kconfig
#ifdef VENDOR_EDIT
config OPPO_SHUTDOWN_DETECT
        bool "OPPO shutdown hang detect"
        default y
        help
            define this config to init oppo oppo_shutdown_detect.
#endif /* VENDOR_EDIT */
```
